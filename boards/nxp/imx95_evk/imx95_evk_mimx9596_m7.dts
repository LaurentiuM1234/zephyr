/*
 * Copyright 2024 NXP
 *
 * SPDX-License-Identifier: Apache-2.0
 */

/dts-v1/;

#include <nxp/nxp_imx95.dtsi>
#include "imx95_evk_mimx9596-pinctrl.dtsi"

/ {
	model = "NXP i.MX95 EVK";
	compatible = "nxp";

	chosen {
		zephyr,sram = &dram;
		zephyr,console = &lpuart3;
		zephyr,shell-uart = &lpuart3;
	};

	dram: memory@80000000 {
		reg = <0x80000000 DT_SIZE_K(256)>;
	};
};

&lpuart3 {
	status = "okay";
	current-speed = <115200>;
	pinctrl-0 = <&uart3_default>;
	pinctrl-names = "default";
};
