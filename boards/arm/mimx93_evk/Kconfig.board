## boards/arm/mimx93_evk/Kconfig.board
```kconfig
# Copyright 2024 NXP
# SPDX-License-Identifier: Apache-2.0

config BOARD_MIMX93_EVK_CM33
	bool "NXP i.MX93 EVK"
	depends on SOC_SERIES_MIMX93_CM33
	select SOC_PART_NUMBER_MIMX9352CVUXK
```

## boards/arm/mimx93_evk/Kconfig.defconfig
```kconfig
# Copyright 2024 NXP
# SPDX-License-Identifier: Apache-2.0

if BOARD_MIMX93_EVK_CM33

config BOARD
	default "mimx93_evk_cm33"

endif # BOARD_MIMX93_EVK_CM33
```

## boards/arm/mimx93_evk/mimx93_evk_cm33_defconfig
```kconfig
# Copyright 2024 NXP

CONFIG_SOC_SERIES_MIMX93_CM33=y
CONFIG_SOC_MIMX93_CM33=y
CONFIG_BOARD_MIMX93_EVK_CM33=y
CONFIG_CLOCK_CONTROL=y
CONFIG_XIP=n
CONFIG_SERIAL=y
CONFIG_CONSOLE=y
CONFIG_PINCTRL=y
```

## boards/nxp/imx95_evk/imx95_evk_mimx9596_m7_defconfig
```kconfig
# not needed ATM
CONFIG_XIP=n

# Lauterbach configurations
CONFIG_THREAD_MONITOR=y
CONFIG_THREAD_STACK_INFO=y
CONFIG_INIT_STACKS=y
CONFIG_TRACING=y
CONFIG_TRACING_OBJECT_TRACKING=y
CONFIG_TRACING_SYSCALL=y
CONFIG_TRACING_THREAD=y
CONFIG_TRACING_WORK=y
CONFIG_TRACING_ISR=y
CONFIG_TRACING_SEMAPHORE=y
CONFIG_TRACING_MUTEX=y
CONFIG_TRACING_CONDVAR=y
CONFIG_TRACING_QUEUE=y
CONFIG_TRACING_FIFO=y
CONFIG_TRACING_LIFO=y
CONFIG_TRACING_STACK=y
CONFIG_TRACING_MESSAGE_QUEUE=y
CONFIG_TRACING_MAILBOX=y
CONFIG_TRACING_PIPE=y
CONFIG_TRACING_HEAP=y
CONFIG_TRACING_MEMORY_SLAB=y
CONFIG_TRACING_TIMER=y
CONFIG_TRACING_EVENT=y
```

## boards/xtensa/nxp_adsp_imx8m/nxp_adsp_imx8m_defconfig
```kconfig
# SPDX-License-Identifier: Apache-2.0

CONFIG_MAIN_STACK_SIZE=3072

CONFIG_SOC_SERIES_NXP_IMX8M=y
CONFIG_SOC_MIMX8M_ADSP=y
CONFIG_BOARD_NXP_ADSP_IMX8M=y

CONFIG_GEN_ISR_TABLES=y
CONFIG_GEN_IRQ_VECTOR_TABLE=n

CONFIG_XTENSA_RESET_VECTOR=y

CONFIG_XTENSA_USE_CORE_CRT1=y

CONFIG_XTENSA_SMALL_VECTOR_TABLE_ENTRY=y

CONFIG_BUILD_OUTPUT_BIN=n

CONFIG_DCACHE_LINE_SIZE=128

# enable uart driver
CONFIG_SERIAL=y

# clock configuration
CONFIG_CLOCK_CONTROL=y

# console (remote proc console by default)
CONFIG_CONSOLE=y

# uart console (overrides remote proc console)
CONFIG_UART_CONSOLE=y

# enable pin controller
CONFIG_PINCTRL=y

# interrupt-related configurations
CONFIG_MULTI_LEVEL_INTERRUPTS=y
CONFIG_2ND_LEVEL_INTERRUPTS=y
CONFIG_2ND_LVL_ISR_TBL_OFFSET=32
CONFIG_MAX_IRQ_PER_AGGREGATOR=64
CONFIG_NUM_2ND_LEVEL_AGGREGATORS=3
CONFIG_2ND_LVL_INTR_00_OFFSET=19
CONFIG_2ND_LVL_INTR_01_OFFSET=20
CONFIG_2ND_LVL_INTR_02_OFFSET=21
```

## drivers/clock_control/Kconfig.arm_scmi
```kconfig
# Copyright 2024 NXP

config CLOCK_CONTROL_ARM_SCMI
	bool "Some message here"
	default y
	depends on DT_HAS_ARM_SCMI_CLOCK_ENABLED
	select ARM_SCMI_CLK_HELPERS
	help
	  Some message here.
```

## drivers/dma/Kconfig.nxp_dummy_dma
```kconfig
# Copyright 2023 NXP
# SPDX-License-Identifier: Apache-2.0

config DMA_NXP_DUMMY_DMA
	bool "Some helpful message should go here"
	default y
	depends on DT_HAS_NXP_DUMMY_DMA_ENABLED
	help
		Some helpful message should go here.
```

## drivers/dma/Kconfig.nxp_edma
```kconfig
# Copyright 2023 NXP
# SPDX-License-Identifier: Apache-2.0

config DMA_NXP_EDMA
	bool "NXP enhanced Direct Memory Access (eDMA) driver"
	default y
	depends on DT_HAS_NXP_EDMA_ENABLED
	help
		Enable driver for NXP's eDMA IP.

if DMA_NXP_EDMA

config DMA_NXP_EDMA_HAS_CHAN_MUX
	bool "Set if at least one eDMA instance is MUX-capable"
	default n
	help
		Set this configuration if at least one EDMA
		instance is MUX-capable (meaning at least one
		channel can be used by multiple peripherals).

config DMA_NXP_EDMA_MAX_ALIGN
	int "Some helpful message should go here"
	default 64
	help
		Some helpful message should go here.

config DMA_NXP_EDMA_ENABLE_HALFMAJOR_IRQ
	bool "Set if CPU should be interrupted when CITER = BITER / 2"
	default n
	help
		Enable this configuration if the CPU should be
		interrupted when CITER = BITER / 2. Using this,
		the CPU will be interrupted when CITER = BITER and
		when CITER = BITER / 2.

endif # DMA_NXP_EDMA
```

## drivers/firmware/Kconfig
```kconfig
# Copyright 2024 NXP
# SPDX-License-Identifier: Apache-2.0

menu "Firmware drivers"

config ARM_SCMI
	bool "TODO"
	default n
	depends on ARM || ARM64
	help
	  TODO

source "drivers/firmware/scmi/Kconfig"

endmenu
```

## drivers/firmware/scmi/Kconfig
```kconfig
# Copyright 2024 NXP
# SPDX-License-Identifier: Apache-2.0

if ARM_SCMI

config ARM_SCMI_MAILBOX_TRANSPORT
	bool "SCMI transport based on shared memory and doorbells"
	default y
	depends on DT_HAS_ARM_SCMI_ENABLED
	select ARM_SCMI_TRANSPORT_HAS_STATIC_CHANNELS
	help
	  TODO

config ARM_SCMI_TRANSPORT_HAS_STATIC_CHANNELS
	bool "Transport layer has static channels"
	default n
	help
	  Enable this if the SCMI transport layer uses static channels.
	  What this is means is that the transport layer will place all
	  of its channels in a special section from which the protocols
	  will be able to obtain references. This is option is recommended
	  for transport layers which don't require a complicated channel
	  allocation scheme.

config ARM_SCMI_SHMEM_INIT_PRIORITY
	int "TODO"
	default 1
	help
	  TODO

config ARM_SCMI_TRANSPORT_INIT_PRIORITY
	int "TODO"
	default 5
	help
	  TODO

config ARM_SCMI_CORE_INIT_PRIORITY
	int "TODO"
	default 6
	help
	  TODO

config ARM_SCMI_CORE_HEAP_SIZE
	int "TODO"
	default 1024
	help
	  TODO

config ARM_SCMI_CLK_HELPERS
	bool "TODO"
	default y
	depends on DT_HAS_ARM_SCMI_CLOCK_ENABLED
	help
	  TODO

config ARM_SCMI_PINCTRL_HELPERS
	bool "TODO"
	default y
	depends on DT_HAS_ARM_SCMI_PINCTRL_ENABLED
	help
	  TODO

config ARM_SCMI_PINCTRL_MAX_CONFIG_COUNT
	int "TODO"
	default 10
	help
	  TODO

endif # ARM_SCMI
```

## drivers/interrupt_controller/Kconfig.nxp_irqsteer
```kconfig
# Copyright 2023 NXP
# SPDX-License-Identifier: Apache-2.0

config NXP_IRQSTEER
	bool "IRQ_STEER interrupt controller for NXP chips"
	default y
	depends on DT_HAS_NXP_IRQSTEER_INTC_ENABLED
	depends on MULTI_LEVEL_INTERRUPTS
	depends on XTENSA
	help
		The IRQSTEER INTC provides support for MUX-ing
		multiple interrupts from peripheral to one or
		more CPU interrupt lines. This is used for CPUs
		such as XTENSA DSPs.

config NXP_IRQSTEER_ISR_THRESHOLD
	int "Error threshold for a dispatcher's ISR"
	default 5
	depends on NXP_IRQSTEER
	help
		This config controls how many times a
		dispatcher's ISR is allowed to iterate
		over its assigned interrupt status register
		before it can conclude that an interrupt
		will get retriggered ad-infinitum (or at
		least for an unacceptable number of times).
```

## dts/bindings/clock/nxp,imx-ccm-rev3.yaml
```yaml
# Copyright 2023 NXP
# SPDX-License-Identifier: Apache-2.0

description: i.MX CCM (Clock Controller Module) Rev 3 IP node

compatible: "nxp,imx-ccm-rev3"

include: [clock-controller.yaml, base.yaml]

properties:
  "#clock-cells":
    const: 1
    description: |
      Number of clock cells a clock consummer must specify.

      The clocks property must have the following structure:
      	clocks = <&ccm CLOCK_ID1>, <&ccm CLOCK_ID2>...

      where CLOCK_IDx is a value extracted from imx93_ccm.h.
  clocks-assume-on:
    type: array
    required: false
  assigned-clocks:
    type: array
    required: false
  assigned-clock-parents:
    type: array
    required: false
  assigned-clock-rates:
    type: array
    required: false

clock-cells:
  - name
```

## dts/bindings/clock/nxp,imx93-ccm.yaml
```yaml
# Copyright (c) 2017, NXP
# SPDX-License-Identifier: Apache-2.0

description: i.MX CCM (Clock Controller Module) IP node

compatible: "nxp,imx93-ccm"

include: [clock-controller.yaml, base.yaml]

properties:
  reg:
    required: true

  "#clock-cells":
    const: 2

clock-cells:
  - clock_name
  - frequency
```

## dts/bindings/dai/nxp,dai-esai.yaml
```yaml
# Copyright 2024 NXP
# SPDX-License-Identifier: Apache-2.0

description: NXP Enhance Serial Audio Interface (ESAI) node

compatible: "nxp,dai-esai"

include: base.yaml

properties:
  reg:
    required: true
  dai-index:
    type: int
    description: |
      Use this property to specify the index of the DAI. At the
      moment, this is only used by SOF to fetch the "struct device"
      associated with the DAI whose index Linux passes to SOF
      through an IPC. If this property is not specified, the DAI
      index will be considered 0.
```

## dts/bindings/dai/nxp,dai-sai.yaml
```yaml
# Copyright 2023 NXP
# SPDX-License-Identifier: Apache-2.0

description: NXP Synchronous Audio Interface (SAI) node

compatible: "nxp,dai-sai"

include: base.yaml

properties:
  reg:
    required: true
  mclk-is-output:
    required: false
    type: boolean
    description: |
      Use this property to set the SAI MCLK as output or as input.
      By default, if this property is not specified, MCLK will be
      set as input. Setting the MCLK as output for SAIs which don't
      support MCLK configuration will result in a BUILD_ASSERT()
      failure.
  rx-fifo-watermark:
    required: false
    type: int
    description: |
      Use this property to specify the watermark value for the TX
      FIFO. This value needs to be in FIFO words (NOT BYTES). This
      value needs to be in the following interval: (0, DEFAULT_FIFO_DEPTH],
      otherwise a BUILD_ASSERT() failure will be raised.
  tx-fifo-watermark:
    required: false
    type: int
    description: |
      Use this property to specify the watermark value for the RX
      FIFO. This value needs to be in FIFO words (NOT BYTES). This
      value needs to be in the following interval: (0, DEFAULT_FIFO_DEPTH],
      otherwise a BUILD_ASSERT() failure will be raised.
  interrupts:
    required: true
  fifo-depth:
    required: false
    type: int
    description: |
      Use this property to set the FIFO depth that will be reported
      to other applications calling dai_get_properties(). This value
      should be in the following interval: (0, DEFAULT_FIFO_DEPTH],
      otherwise a BUILD_ASSERT() failure will be raised.
      By DEFAULT_FIFO_DEPTH we mean the actual (hardware) value of
      the FIFO depth. This is needed because some applications (e.g: SOF)
      use this value to compute the DMA burst size, in which case
      DEFAULT_FIFO_DEPTH cannot be used. Generally, reporting a false
      FIFO depth should be avoided. Please note that the sanity check
      for tx/rx-fifo-watermark uses DEFAULT_FIFO_DEPTH instead of this
      value so use with caution. If unsure, it's better to simply not
      use this property, in which case the reported value will be
      DEFAULT_FIFO_DEPTH.
```

## dts/bindings/dai/nxp,sai.yaml
```yaml
# Copyright 2023 NXP
# SPDX-License-Identifier: Apache-2.0

description: NXP Synchronous Audio Interface (SAI) node

compatible: "nxp,sai"

include: base.yaml

properties:
  reg:
    required: true
  mclk-is-output:
    required: false
    type: boolean
  rx-fifo-watermark:
    required: false
    type: int
  tx-fifo-watermark:
    required: false
    type: int
```

## dts/bindings/dma/nxp,dummy-dma.yaml
```yaml
# Copyright 2023 NXP
# SPDX-License-Identifier: Apache-2.0

description: NXP dummy DMA node.

compatible: "nxp,dummy-dma"

include: base.yaml

properties:
  dma-channels:
    required: true
    type: int
```

## dts/bindings/dma/nxp,edma.yaml
```yaml
# Copyright 2023 NXP
# SPDX-License-Identifier: Apache-2.0

description: NXP enhanced Direct Memory Access (eDMA) node

compatible: "nxp,edma"

include: [dma-controller.yaml, base.yaml]

properties:
  reg:
    required: true
  dma-channels:
    required: false
  valid-channels:
    required: false
    type: array
  "#dma-cells":
    const: 1
  channel-mux:
    type: boolean
    required: false
```

## dts/bindings/firmware/arm,scmi-pinctrl.yaml
```yaml
# Copyright 2024 NXP
# SPDX-License-Identifier: Apache-2.0

description: System Control and Management Interface (SCMI)

compatible: "arm,scmi-pinctrl"

include: [base.yaml]

properties:
  reg:
    required: true
    const: [0x19]

child-binding:
  description: TODO
  properties:
    pinmux:
      required: true
      type: array
```

## dts/bindings/firmware/nxp,imx-scu.yaml
```yaml
# Copyright 2023 NXP
# SPDX-License-Identifier: Apache-2.0

description: Add better description here

compatible: "nxp,imx-scu"

include: base.yaml

properties:
  mbox:
    required: true
    type: array
```

## soc/arm/nxp_imx/mimx93_cm33/Kconfig.defconfig.mimx93
```kconfig
# Copyright 2024 NXP
# SPDX-License-Identifier: Apache-2.0

if SOC_MIMX93_CM33

config SOC
	default "mimx9352_cm33"

# TODO: what's this for?
config FLASH_SIZE
	default $(dt_chosen_reg_size_int,$(DT_CHOSEN_Z_FLASH),0,K)

config FLASH_BASE_ADDRESS
	default $(dt_chosen_reg_addr_hex,$(DT_CHOSEN_Z_FLASH))

config NUM_IRQS
	int
	default 240

# TODO: set this to the actual value
config SYS_CLOCK_HW_CYCLES_PER_SEC
	int
	default 200000000

config PINCTRL_IMX
	default y
	depends on PINCTRL

endif # SOC_MIMX93_CM33
```

## soc/arm/nxp_imx/mimx93_cm33/Kconfig.defconfig.series
```kconfig
# Copyright 2024 NXP
# SPDX-License-Identifier: Apache-2.0

if SOC_SERIES_MIMX93_CM33

# TODO: fix this
config SOC_SERIES
	default "mimx93_cm33"

source "soc/arm/nxp_imx/mimx93_cm33/Kconfig.defconfig.mimx93*"

endif # SOC_SERIES_MIMX93_CM33
```

## soc/arm/nxp_imx/mimx93_cm33/Kconfig.series
```kconfig
# Copyright 2024 NXP
# SPDX-License-Identifier: Apache-2.0

config SOC_SERIES_MIMX93_CM33
	bool "NXP i.MX93 CM33 Core Series"
	select ARM
	select SOC_FAMILY_IMX
	select CPU_HAS_FPU
	select CPU_HAS_MPU
	select CPU_HAS_ARM_MPU
	select ARM_MPU
	select CPU_CORTEX_M33
	select ARMV8_M_DSP
	help
		Enable support for i.MX93 CM33 series.
```

## soc/arm/nxp_imx/mimx93_cm33/Kconfig.soc
```kconfig
# Copyright 2024 NXP
# SPDX-License-Identifier: Apache-2.0

choice
	prompt "NXP i.MX93 CM33 Selection"
	depends on SOC_SERIES_MIMX93_CM33

	config SOC_MIMX93_CM33
		bool "NXP i.MX93 CM33"
		select HAS_MCUX
endchoice

if SOC_MIMX93_CM33

config SOC_PART_NUMBER_MIMX9352CVUXK
	bool

config SOC_PART_NUMBER_MIMX9352DVUXM
	bool

config SOC_PART_NUMBER_MIMX93_CM33
	string
	default "MIMX9352CVUXK_cm33" if  SOC_PART_NUMBER_MIMX9352CVUXK
	default "MIMX9352DVUXM_cm33" if  SOC_PART_NUMBER_MIMX9352DVUXM

endif # SOC_MIMX93_CM33
```

## soc/nxp/imx/imx95/Kconfig.defconfig
```kconfig
# Copyright 2024 NXP
# SPDX-License-Identifier: Apache-2.0

if SOC_MIMX9596_M7

config SYS_CLOCK_HW_CYCLES_PER_SEC
	default 800000000

config NUM_IRQS
	int
	default 230 # TODO: what about the gap after 229?

config FLASH_SIZE
	default $(dt_node_reg_size_int,/soc/memory@80000000,0,K)

config FLASH_BASE_ADDRESS
	default $(dt_node_reg_addr_hex,/soc/memory@80000000)

endif
```
