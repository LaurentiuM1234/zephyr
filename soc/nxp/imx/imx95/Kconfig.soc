## soc/nxp/imx/imx95/Kconfig.soc
```kconfig
# Copyright 2024 NXP
# SPDX-License-Identifier: Apache-2.0

config SOC_SERIES_IMX95
	bool
	select SOC_FAMILY_NXP_IMX

config SOC_SERIES
	default "imx95" if SOC_SERIES_IMX95

config SOC_MIMX9596
	bool
	select SOC_SERIES_IMX95

config SOC_MIMX9596_M7
	bool
	select SOC_MIMX9596
	help
	  TODO

config SOC
	default "mimx9596" if SOC_MIMX9596

config SOC_PART_NUMBER_MIMX9596AVYXN
	bool

config SOC_PART_NUMBER_MIMX9596AVZXN
	bool
	
config SOC_PART_NUMBER
	default "MIMX9596AVYXN" if SOC_PART_NUMBER_MIMX9596AVYXN
	default "MIMX9596AVZXN" if SOC_PART_NUMBER_MIMX9596AVZXN
```
